.extern _start 
.section .hardware_init,"ax",@progbits 

#Header for HYPER.EXE
.org 0
.byte 0x00, 0x83, 0x12, 0x88, 0x00, 0x83, 0x12, 0x88, 0x00, 0x83, 0x12, 0x88
.byte 0x00, 0x83, 0x12, 0x88, 0x00, 0x83, 0x12, 0x88, 0x00, 0x83, 0x12, 0x88
.byte 0x00, 0x83, 0x12, 0x88, 0x00, 0x83, 0x12, 0x88, 0x00, 0x83, 0x12, 0x88
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.byte 0x00, 0x83, 0x12, 0x88, 0x00, 0x83, 0x12, 0x88, 0x00, 0x4f
.org 0xe04

.global _hardware_init 
.ent        _hardware_init 
_hardware_init: 

// disable write back data cache 

       mfcr        r5, cr4 
       nop 
       li        r7, 0x80 
       andri        r6, r5, 0x80 
       cmp.c        r7, r6                # Check under WB mode? 
       bne        under_wt 
       nop 
under_wb: 
       la        r7, tgl_wb 
       cache        0x1f, [r7, 0]        # force write out dirty entry and set invalid 
       nop 
       nop 
       nop 
tgl_wb: 
       cache        0x1d, [r7, 0]        # toggle write-back function 
       nop 
under_wt:                                # Processor is under write-through mode 

//Interrupt disable 
       li r4, 0x0 
       mtcr r4, cr0 
       
//change exception vector base to 0xa0000000 
       nop
       nop
       nop
       nop
       nop
       li r4, 0xa0000000 
       mtcr r4, cr3 
       nop
       nop
       nop
       nop
       nop
       
       la r0,_stack 

// Enable BIU Write buffer 
       mfcr        r5, cr4 
       nop
       nop
       nop
       nop
       nop 
       li        r7, 0x01 
       andri        r6, r5, 0x01 
       cmp.c        r7, r6                // Check under write buffer mode? 
       beq        wbuff_on 
       nop 
wbuff_off: 
       la        r7, biu_wben 
       cache        0x1a, [r7, 0]        // drain write buffer
       nop 
       nop 
       nop 
biu_wben: 
       cache        0x1b, [r7, 0]        // toggle write buffer function 
       nop 
       nop
       nop
wbuff_on:                                // Processor is write buffer mode 

        j        _start; 
               
               .end        _hardware_init 
